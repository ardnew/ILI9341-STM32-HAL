/*
 * boing.c
 *
 *  Created on: Jan 21, 2020
 *      Author: andrew
 */

#include "boing.h"

#include "cmsis_os.h"
#include "stdlib.h"
#include "string.h"

// -----------------------------------------------------------------------------
//  constant definitions
// -----------------------------------------------------------------------------

ili9341_color_t const BOING_COLOR_PLOT_COLOR  = (ili9341_color_t)0xC618;
ili9341_color_t const BOING_COLOR_PLOT_SHADOW = (ili9341_color_t)0x7BEF;
ili9341_color_t const BOING_COLOR_BG_COLOR    = (ili9341_color_t)0xAD75;
ili9341_color_t const BOING_COLOR_BG_SHADOW   = (ili9341_color_t)0x5285;
ili9341_color_t const BOING_COLOR_GRID_COLOR  = (ili9341_color_t)0xA815;
ili9341_color_t const BOING_COLOR_GRID_SHADOW = (ili9341_color_t)0x600C;
ili9341_color_t const BOING_COLOR_BALL_P1     = (ili9341_color_t)0x000F;
ili9341_color_t const BOING_COLOR_BALL_P2     = (ili9341_color_t)0x07FF;

boing_pointf_t const BOING_EDGE_MIN = (boing_pointf_t){
    .x = 15.0F,
    .y = 0.0F
};
boing_pointf_t const BOING_EDGE_MAX = (boing_pointf_t){
    .x = __BOING_PLOT_WIDTH__ - __BOING_BALL_WIDTH__ - 1,
    .y = 123.0F
};

float const BOING_ROTATION_FX  = +0.50; // X velocity factor
float const BOING_VELOCITY_DY  = +0.06; // per-frame change in Y velocity
float const BOING_BOUNCE_VEL_Y = -3.50; // Y velocity on ball bounce

// -----------------------------------------------------------------------------
//  global variables
// -----------------------------------------------------------------------------

uint32_t _boing_start;
uint32_t _boing_frame; // frames-per-second estimate

void boing_init(boing_ball_t *ball)
{
  _boing_start = osKernelSysTick();
  _boing_frame = 0U;

  if (NULL != ball) {
    ball->pos   =   (boing_pointf_t){ .x = 20.0F, .y = BOING_EDGE_MAX.y   };
    ball->pre   =   (boing_pointf_t){ .x = 20.0F, .y = BOING_EDGE_MAX.y   };
    ball->vel   = (boing_velocity_t){ .x =  1.0F, .y = BOING_BOUNCE_VEL_Y };
    ball->frame = 3;
    memset(ball->color, 0, sizeof(ball->color));
    memset(ball->spi_tx, 0, sizeof(ball->spi_tx));
  }
}

void boing(ili9341_t *lcd, boing_ball_t *ball)
{
  if (NULL == ball)
    { return; }

  ball->pre = ball->pos;

  ball->pos.x += ball->vel.x;
  ball->pos.y += ball->vel.y;

  ball->vel.y += BOING_VELOCITY_DY;

  // hit left or right wall
  if ((ball->pos.x <= BOING_EDGE_MIN.x) || (ball->pos.x >= BOING_EDGE_MAX.x))
    { ball->vel.x *= -1.0F; }

  // hit ground
  if (ball->pos.y >= BOING_EDGE_MAX.y) {
    ball->pos.y = BOING_EDGE_MAX.y;
    ball->vel.y = BOING_BOUNCE_VEL_Y;
  }

  // determine screen area to update.  this is the bounds of the ball's prior
  // and current positions, so the old ball is fully erased and new ball is
  // fully drawn.
  static boing_point_t _dim = (boing_point_t){
    .x = __BOING_BALL_WIDTH__,
    .y = __BOING_BALL_HEIGHT__
  };
  int16_t _pos_x = __FROUND(int16_t, ball->pos.x + _dim.x);
  int16_t _pos_y = __FROUND(int16_t, ball->pos.y + _dim.y);
  int16_t _pre_x = __FROUND(int16_t, ball->pre.x + _dim.x);
  int16_t _pre_y = __FROUND(int16_t, ball->pre.y + _dim.y);

  boing_point_t min;
  boing_point_t max;
  boing_point_t size;

  // determine bounds of prior and new positions
  min.x = __FROUND(int16_t, ball->pos.x);
  min.y = __FROUND(int16_t, ball->pos.y);
  if (min.x > ball->pre.x)
    { min.x = __FROUND(int16_t, ball->pre.x); }
  if (min.y > ball->pre.y)
    { min.y = __FROUND(int16_t, ball->pre.y); }

  max.x = _pos_x;
  max.y = _pos_y;
  if (max.x < _pre_x)
    { max.x = _pre_x; }
  if (max.y < _pre_y)
    { max.y = _pre_y; }

  size.x = max.x - min.x + 1;
  size.y = max.y - min.y + 1;

  // ball animation frame is incremented opposite the ball's X velocity
  float _frame = ball->vel.x * BOING_ROTATION_FX;
  ball->frame -= __FROUND(int16_t, _frame);
  if (ball->frame < 0)
    { ball->frame += __BOING_BALL_FRAME_NB__; } // constrain from 0 to 13
  else if (ball->frame >= __BOING_BALL_FRAME_NB__)
    { ball->frame -= __BOING_BALL_FRAME_NB__; }

  // set 7 panels to color 1, 7 to color 2, based on frame number. this makes
  // the ball spin. entries 0(=clear) and 1(=shadow) are skipped.
  for (uint16_t i = 0; i < __BOING_BALL_FRAME_NB__; ++i) {
    uint16_t fi = ball->frame + i;
    if ((fi % __BOING_BALL_FRAME_NB__) < __BOING_BALL_FRAME_HF__)
      { ball->color[i + 2] = BOING_COLOR_BALL_P1; }
    else
      { ball->color[i + 2] = BOING_COLOR_BALL_P2; }
  }

  // only the changed rectangle is written to the rendering buffer
  uint16_t *push;
  uint16_t le, _le;
  int16_t bi = 0, bx, gx;

  boing_point_t b = (boing_point_t){
    .x = min.x - __FROUND(int16_t, ball->pos.x),
    .y = min.y - __FROUND(int16_t, ball->pos.y)
  };
  boing_point_t g = (boing_point_t){
    .x = min.x,
    .y = min.y
  };

  // wait for previous DMA transfer to complete if any
  ili9341_transmit_wait(lcd);

  // select target region
  ili9341_spi_tft_set_address_rect(lcd,
      min.x, min.y, min.x + size.x - 1, min.y + size.y - 1);
  ili9341_spi_tft_select(lcd);

  HAL_GPIO_WritePin(lcd->data_command_port, lcd->data_command_pin, __GPIO_PIN_SET__);

  for (int16_t y = 0; y < size.y; ++y) {

    push = ball->spi_tx[bi];

    bx = b.x; // copies of actual values are used and mutated below
    gx = g.x; //

    for (int16_t x = 0; x < size.x; ++x) {

      _le = BOING_PLOT[g.y][gx / 8] & (0x80 >> (gx & 0x7));

      // is current pixel inside the ball bitmap region?
      if ( ( bx  >= 0 ) && ( bx  < __BOING_BALL_WIDTH__  ) &&
           ( b.y >= 0 ) && ( b.y < __BOING_BALL_HEIGHT__ ) ) {

        le = BOING_BALL[b.y][bx / 2]; // use low 4 bits by default
        if (ibNOT(bx & 1))
          { le >>= 4U; } // shift in high 4 bits
        le &= 0xF; // mask off any leading bits

        switch (le) {

          case  0: // outside of ball, outside of shadow
            le = _le
              ? BOING_COLOR_PLOT_SHADOW
              : BOING_COLOR_PLOT_COLOR;
            break;

          case  1: // outside of ball, inside of shadow
            le = _le
              ? BOING_COLOR_GRID_SHADOW
              : BOING_COLOR_BG_SHADOW;
            break;

          default: // inside of ball
            le = ball->color[le];
            break;
        }

      }
      // outside ball bitmap. just draw background bitmap
      else {
        le = _le
          ? BOING_COLOR_PLOT_SHADOW
          : BOING_COLOR_PLOT_COLOR;
      }

      *push = __LEu16(&le);

      ++push;
      ++bx;
      ++gx;
    }

    // wait for previous DMA transfer to complete
    ili9341_transmit_wait(lcd);
    ili9341_transmit_color(lcd, size.x * 2, (ball->spi_tx[bi]), ibNo);
    bi = 1 - bi;

    ++(b.y);
    ++(g.y);
  }

  ili9341_spi_tft_release(lcd);
  ili9341_transmit_wait(lcd);
}

// -----------------------------------------------------------------------------
//  graphics bitmap tables
// -----------------------------------------------------------------------------

const uint8_t BOING_PLOT[__BOING_PLOT_HEIGHT__][__BOING_PLOT_WIDTH__ / (8U / __BOING_PLOT_BPP__)] = {
  { 0X00,0X00,0X00,0X00,0X00,0X00,0X00,0X00,0X00,0X00,0X00,0X00,0X00,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0X00,0X00 },
  { 0X00,0X00,0X00,0X00,0X00,0X00,0X00,0X00,0X00,0X00,0X00,0X00,0X00,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0X00,0X00 },
  { 0X00,0X00,0X00,0X00,0X00,0X00,0X00,0X00,0X00,0X00,0X00,0X00,0X00,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0X00,0X00 },
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  { 0X00,0X00,0X00,0X00,0X00,0X00,0X00,0X00,0X00,0X00,0X00,0X00,0X00,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0X00,0X00 },
};

const uint8_t BOING_BALL[__BOING_BALL_HEIGHT__][__BOING_BALL_WIDTH__ / (8U / __BOING_BALL_BPP__)] = {
  { 0X00,0X00,0X00,0X00,0X00,0X00,0X00,0X00,0X00,0X00,0X00,0X00,0X00,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0X00,0X00 },
  { 0X00,0X00,0X00,0X00,0X00,0X00,0X00,0X00,0X00,0X00,0X00,0X00,0X00,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0X00,0X00 },
  { 0X00,0X00,0X00,0X00,0X00,0X00,0X00,0X00,0X00,0X00,0X00,0X00,0X00,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0X00,0X00 },
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  { 0X00,0X00,0X00,0X00,0X00,0X00,0X00,0X00,0X00,0X00,0X00,0X00,0X00,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0X00,0X00 }
};

